## boards/shields/sculpt_ble/Kconfig.defconfig
```kconfig
if SHIELD_SCULPT_BLE

config ZMK_KEYBOARD_NAME
    default "Sculpt BLE"

config GPIO_PCF857X
    default y
    
config I2C
    default y

config I2C_NRFX
    default y  

config ZMK_BLE_CLEAR_BONDS_ON_START
    def_bool y  
    
endif
```

## config/west.yml
```yaml
manifest:
  defaults:
    revision: v0.3
  remotes:
    - name: zmkfirmware
      url-base: https://github.com/zmkfirmware
    - name: dannygrob
      url-base: https://github.com/dannygrob
  projects:
    - name: zmk
      revision: pcf8575-support
      url: https://github.com/dannygrob/zmk-pcf8575
      import: app/west.yml
  self:
    path: config
```
